## base_external/package/ldd/Config.in
```kconfig
config BR2_PACKAGE_LDD
	bool "ldd modules"
	depends on BR2_LINUX_KERNEL
	help
	  Includes the ldd package from assignment 7.
```

## base_external/package/ldd3/Config.in
```kconfig
config BR2_PACKAGE_LDD3_MODULES
	bool "ldd3 modules"
	help
	  Includes the ldd package from assignment 7.
```
